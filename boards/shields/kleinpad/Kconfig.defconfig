## boards/shields/kleinpad/Kconfig.defconfig
```kconfig
if SHIELD_KLEINPAD

# Name must be less than 16 characters long!
config ZMK_KEYBOARD_NAME
    default "KleinPad"

endif
```

## boards/shields/kleinpad/Kconfig.shield
```kconfig
# No whitespace after the comma or in your keyboard name!
config SHIELD_KLEINPAD
    def_bool $(shields_list_contains,kleinpad)
```
